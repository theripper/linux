## drivers/amlogic/dvb_tv/Kconfig
```kconfig
#
# WetekPlay driver configuration
#

menu "WetekPlay driver"

config AM_DVB
	tristate "WetekPlay driver"
	default y
	select DVB_CORE
	help
		Select to enable WetekPlay driver.
endmenu
```
